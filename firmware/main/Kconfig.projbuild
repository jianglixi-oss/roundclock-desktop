## firmware/main/Kconfig.projbuild
```kconfig
menu "Round screen test"
config SCREEN_INIT_STD
    bool "Use alternate Xiaozhi STD panel initialization"
    default n
    help
        Default is the Taiji Pi PDM board revision matching the attached configuration.
        This changes only the LCD initialization table, not audio hardware.
endmenu
```

## firmware/sdkconfig.defaults
```kconfig
CONFIG_IDF_TARGET="esp32s3"
CONFIG_ESPTOOLPY_FLASHSIZE_16MB=y
CONFIG_ESPTOOLPY_FLASHMODE_DIO=y
CONFIG_ESPTOOLPY_FLASHFREQ_40M=y
CONFIG_PARTITION_TABLE_CUSTOM=y
CONFIG_PARTITION_TABLE_CUSTOM_FILENAME="partitions.csv"
CONFIG_ESP_CONSOLE_USB_SERIAL_JTAG=y
CONFIG_ESP_CONSOLE_SECONDARY_NONE=y
CONFIG_SPIRAM=y
CONFIG_SPIRAM_MODE_OCT=y
CONFIG_SPIRAM_SPEED_80M=y
CONFIG_SPIRAM_USE_MALLOC=y
CONFIG_SPIRAM_MALLOC_RESERVE_INTERNAL=32768
CONFIG_HTTPD_MAX_REQ_HDR_LEN=1024
CONFIG_LWIP_SNTP_MAX_SERVERS=2
CONFIG_WS_TRANSPORT=y
CONFIG_ESP_WS_CLIENT_SEPARATE_TX_LOCK=y
CONFIG_LOG_DEFAULT_LEVEL_INFO=y
```
